// Код для калибровки магнитометра
#include <Arduino.h>          // Подключаем библиотеку Arduino для базовых функций (например, Serial и delay)
#include <Wire.h>             // Подключаем библиотеку Wire для работы с I2C (для общения с магнитометром)
// Определяем константы для адреса и регистров QMC5883L (магнитометра)
// Адрес устройства на шине I2C (стандартный для QMC5883L)
#define QMC5883L_ADDR 0x0D
// Регистр, из которого читаем данные (X, Y, Z)
#define QMC5883L_REG_DATA 0x00
// Регистры управления: CTRL1 - режим работы, CTRL2 - сброс, CTRL3 - режим измерений
#define QMC5883L_REG_CTRL1 0x09
#define QMC5883L_REG_CTRL2 0x0A
#define QMC5883L_REG_CTRL3 0x0B
// Определяем пины для I2C на ESP32 (стандартные пины для ESP32: SDA на 21, SCL на 22)
const int I2C_SDA = 21;
const int I2C_SCL = 22;
// Структура для хранения данных магнитометра: значения X, Y, Z и флаг успеха чтения
struct MagnetometerData {
  int16_t x, y, z;  // 16-битные целые числа для магнитных полей по осям (в единицах датчика)
  bool success;     // true, если чтение прошло успешно; false, если ошибка
};
// Глобальные переменные для калибровки: минимальные и максимальные значения по осям X и Y
// Инициализируем minX очень большим числом (32767 - максимум для int16_t), maxX - минимальным (-32768)
// Аналогично для Y. Это позволит находить реальные минимумы и максимумы во время калибровки.
int16_t minX = 32767, maxX = -32768;
int16_t minY = 32767, maxY = -32768;
// Вспомогательная функция для нахождения минимума из двух чисел
// Возвращает меньшее из a и b
int16_t min_val(int16_t a, int16_t b) {
  return (a < b) ? a : b;  // Если a меньше b, вернуть a; иначе b
}
// Вспомогательная функция для нахождения максимума из двух чисел
// Возвращает большее из a и b (исправлено: в оригинале была ошибка (a > a), теперь (a > b))
int16_t max_val(int16_t a, int16_t b) {
  return (a > b) ? a : b;  // Если a больше b, вернуть a; иначе b
}
// Функция инициализации QMC5883L
// Настраивает датчик для работы: устанавливает режим непрерывных измерений, сбрасывает и включает датчик
// Возвращает true, если инициализация успешна; false, если устройство не найдено или ошибка связи
bool initializeQMC5883L() {
  // Проверяем, есть ли устройство по адресу QMC5883L_ADDR на шине I2C
  Wire.beginTransmission(QMC5883L_ADDR);
  if (Wire.endTransmission() != 0) return false;  // Если не 0, устройство не отвечает - ошибка
  // Устанавливаем CTRL1: значение 0x1D включает непрерывный режим измерений с частотой 200 Гц и разрешением 2 байта
  Wire.beginTransmission(QMC5883L_ADDR);
  Wire.write(QMC5883L_REG_CTRL1);  // Указываем регистр CTRL1
  Wire.write(0x1D);                // Пишем значение для активации
  if (Wire.endTransmission() != 0) return false;  // Проверяем успех
  delay(10);  // Небольшая пауза для стабилизации
  // Устанавливаем CTRL2: 0x00 - сброс и нормальный режим (без soft reset)
  Wire.beginTransmission(QMC5883L_ADDR);
  Wire.write(QMC5883L_REG_CTRL2);
  Wire.write(0x00);
  if (Wire.endTransmission() != 0) return false;
  delay(10);
  // Устанавливаем CTRL3: 0x01 - включает датчик в режим измерений
  Wire.beginTransmission(QMC5883L_ADDR);
  Wire.write(QMC5883L_REG_CTRL3);
  Wire.write(0x01);
  if (Wire.endTransmission() != 0) return false;
  delay(10);
  return true;  // Все настройки прошли успешно
}
// Функция чтения данных с магнитометра
// Читает сырые значения X, Y, Z из датчика
// Возвращает структуру MagnetometerData с данными или с success=false при ошибке
MagnetometerData readMagnetometer() {
  MagnetometerData data = {0, 0, 0, false};  // Инициализируем структуру с нулями и false
  // Начинаем чтение: указываем регистр данных
  Wire.beginTransmission(QMC5883L_ADDR);
  Wire.write(QMC5883L_REG_DATA);  // Регистр, с которого начнём читать
  if (Wire.endTransmission() != 0) return data;  // Если ошибка, возвращаем пустые данные
  delay(10);  // Ждём, пока датчик подготовит данные (необязательно, но для надёжности)
  // Запрашиваем 6 байт данных (2 байта на каждую ось: X_low, X_high, Y_low, Y_high, Z_low, Z_high)
  if (Wire.requestFrom(QMC5883L_ADDR, 6) == 6) {  // Если получили ровно 6 байт
    uint8_t xLow = Wire.read();   // Младший байт X
    uint8_t xHigh = Wire.read();  // Старший байт X
    uint8_t yLow = Wire.read();   // Младший байт Y
    uint8_t yHigh = Wire.read();  // Старший байт Y
    uint8_t zLow = Wire.read();   // Младший байт Z
    uint8_t zHigh = Wire.read();  // Старший байт Z
    // Собираем 16-битные значения: старший байт сдвигаем влево на 8 бит и объединяем с младшим
    data.x = (int16_t)(xHigh << 8 | xLow);
    data.y = (int16_t)(yHigh << 8 | yLow);
    data.z = (int16_t)(zHigh << 8 | zLow);
    data.success = true;  // Устанавливаем флаг успеха
  }
  return data;  // Возвращаем структуру с данными
}
// Функция калибровки магнитометра
// Сбор данных в течение 15 секунд, пока пользователь вращает устройство, чтобы найти диапазоны X и Y
// Выводит прогресс в Serial, а в конце - найденные минимумы и максимумы
void calibrateMagnetometer() {
  Serial.println("Калибровка магнитометра...");  // Сообщение о начале калибровки
  Serial.println("Вращайте устройство в обе стороны в течение 10-15 секунд");  // Инструкция для пользователя
  int samples = 0;              // Счётчик собранных образцов данных
  unsigned long startTime = millis();  // Время начала калибровки (в миллисекундах)
  // Цикл сбора данных на 15 секунд (15000 мс)
  while (millis() - startTime < 15000) {
    MagnetometerData data = readMagnetometer();  // Читаем данные с датчика
    if (data.success) {  // Если чтение успешно
      // Обновляем минимумы и максимумы для X и Y (Z игнорируем, так как для компаса нужны только X и Y)
      minX = min_val(minX, data.x);  // minX = меньшему из текущего minX и нового data.x
      maxX = max_val(maxX, data.x);  // maxX = большему из текущего maxX и нового data.x
      minY = min_val(minY, data.y);
      maxY = max_val(maxY, data.y);
      samples++;  // Увеличиваем счётчик образцов
      // Каждые 10 образцов выводим прогресс (чтобы не засорять Serial)
      if (samples % 10 == 0) {
        int progress = ((millis() - startTime) * 100) / 15000;  // Процент завершения (от 0 до 100)
        Serial.print("Прогресс: ");Serial.println(progress);
      }
    }
    delay(100);  // Пауза 100 мс между чтениями (чтобы не перегружать I2C и дать время на вращение)
  }
  // После завершения выводим результаты калибровки
  Serial.print("minX: ");Serial.println(minX);  // Диапазон для X: минимум
  Serial.print("maxX: ");Serial.println(maxX);  // Диапазон для X: максимум
  Serial.print("minY: ");Serial.println(minY);  // Диапазон для Y: минимум
  Serial.print("minY: ");Serial.println(maxY);  // Диапазон для Y: максимум
  Serial.println("Скопируйте эти значения в Ваш основной код для компаса");  // Инструкция: скопировать эти значения в основной код компаса
}
// Функция setup: выполняется один раз при запуске ESP32
void setup() {
  Serial.begin(115200);  // Инициализируем Serial для вывода сообщений на скорость 115200 бод
  Serial.println("Калибровка магнитометра QMC5883L");  // Приветственное сообщение
  // Инициализируем I2C с указанными пинами и частотой 100 кГц (стандартная для большинства датчиков)
  Wire.begin();
  Wire.setClock(100000);
  delay(1000);  // Ждём 1 секунду для стабилизации I2C
  // Пытаемся инициализировать QMC5883L
  if (initializeQMC5883L()) {
    Serial.println("Инициализация QMC5883L прошла успешно. Старт калибровки...");  // Успех: начинаем калибровку
    calibrateMagnetometer();  // Запускаем функцию калибровки
  } else {
    Serial.println("Ошибка: QMC5883L не найден. Проверьте подключение.");  // Ошибка: проверь подключение
  }
}
// Функция loop: выполняется бесконечно после setup (здесь ничего не делаем, так как калибровка однократная)
void loop() {
  delay(1000);  // Пауза 1 секунда (чтобы процессор не нагружался зря)
}
